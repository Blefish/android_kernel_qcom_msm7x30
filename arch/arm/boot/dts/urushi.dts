#include <dt-bindings/input/input.h>

#include "semc-mogami.dtsi"

/ {
	model = "SEMC Xperia Ray";
};

&pmicintc {
	keypad@148 {
		linux,keymap = <
			MATRIX_KEY(0, 0, KEY_BACK)
			MATRIX_KEY(0, 1, KEY_HOME)
			MATRIX_KEY(0, 2, KEY_MENU)
			MATRIX_KEY(0, 3, KEY_VOLUMEUP)
			MATRIX_KEY(0, 4, KEY_VOLUMEDOWN)
			>;
		keypad,num-rows = <1>;
		keypad,num-columns = <5>;
		debounce = <10>;
		scan-delay = <2>;
		row-hold = <122000>;
	};
};
